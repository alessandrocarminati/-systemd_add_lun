## systemd_add_lun/Config.in
```kconfig
config BR2_PACKAGE_SYSTEMD_ADD_LUN
    bool "systemd target to scan a given scsi lun"
    help
      systemd target to scan a given scsi lun
```

## systemd_add_lun_q/Config.in
```kconfig
config BR2_PACKAGE_SYSTEMD_ADD_LUN_Q
    bool "systemd target to scan a given scsi lun, c version"
    help
      systemd target to scan a given scsi lun, C version
```
